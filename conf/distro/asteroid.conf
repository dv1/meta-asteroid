## conf/distro/asteroid.conf
```bitbake
# Copyright (C) 2015 Florent Revest <revestflo@gmail.com>
#
# This program is free software; you can redistribute it and/or modify
# it under the terms of the GNU General Public License version 2 as
# published by the Free Software Foundation.
#
# This program is distributed in the hope that it will be useful,
# but WITHOUT ANY WARRANTY; without even the implied warranty of
# MERCHANTABILITY or FITNESS FOR A PARTICULAR PURPOSE.  See the
# GNU General Public License for more details.
#
# You should have received a copy of the GNU General Public License along
# with this program; if not, write to the Free Software Foundation, Inc.,
# 51 Franklin Street, Fifth Floor, Boston, MA 02110-1301 USA.

require conf/distro/oel.conf

MAINTAINER = "Florent Revest <revestflo@gmail.com>"

# Enable commercial license flags everywhere
# LICENSE_FLAGS_ACCEPTED:append = " commercial "

OEL_EXTRA_DISTRO_FEATURES = " \
	acl \
	alsa \
	bluetooth \
	bluez5 \
	gobject-introspection-data \
	largefile \
	ldconfig \
	opengl \
	pam \
	polkit \
	pulseaudio \
	systemd \
	usbgadget \
	usbhost \
	usrmerge \
	wifi \
	wayland \
	xattr \
"

# Distro setup
DISTRO = "asteroid"
DISTRO_NAME = "AsteroidOS"
DISTRO_VERSION ?= "1.1-nightly"

PREFERRED_PROVIDER_jpeg = "libjpeg-turbo"
PREFERRED_PROVIDER_jpeg-native = "libjpeg-turbo-native"

PREFERRED_VERSION_geoclue = "0.12.99"

# For meta-android
ANDROID_EXTRA_INITRAMFS_IMAGE_INSTALL ?= ""

FILESYSTEM_PERMS_TABLES = "files/fs-perms.txt files/asteroidos-fs-perms.txt"

PACKAGE_FEED_URIS = "https://release.asteroidos.org/nightlies/"
PACKAGE_FEED_BASE_PATHS = "ipk"
PACKAGE_FEED_ARCHS = "all anthias armv7vehf-neon bass beluga catfish core2-32 dory firefish harmony hoki inharmony koi lenok minnow mooneye narwhal nemo pike qemux86 ray skipjack smelt sparrow sprat sturgeon swift tetra triggerfish wren"

# This skips the X11 check in meta-gnome
SKIP_META_GNOME_SANITY_CHECK = "1"

OLDEST_KERNEL = "3.4"
```
